// Use keycodes from linux/include/upai/linux/input-event-codes.h

/dts-v1/;
	/plugin/;
	/ {
		compatible = "brcm,bcm2835", "brcm,bcm2708", "brcm,bcm2709";

		fragment@0 {
			target-path = "/";
			__overlay__ {
				keypad: CALCULATOR_KEYBOARD {
					compatible = "gpio-matrix-keypad";
					pinctrl-names = "default";
					pinctrl-0 = <&keypad_pins>;
					debounce-delay-ms = <10>;
	                col-scan-delay-us = <10>;
					wakeup-source = <1>;
	
					row-gpios =	<&gpio 19 0 // calc 13 
							&gpio 27 0 // calc 14   
	                            			&gpio 26 0 // calc 15  
	                            			&gpio 15 0 // calc 16
							&gpio 3 0 // calc 17   
	                            			&gpio 2 0 >; // calc 18 
					
					col-gpios = <&gpio 16 0 // calc 5
								&gpio 5 0 // calc 6
								&gpio 6 0 // calc 7
								&gpio 13 0 // calc 8
								&gpio 9 0 // calc 9
								&gpio 10 0 // calc 10
								&gpio 20 0 // calc 11
								&gpio 11 0 >; // calc 12
	
					linux,keymap = <//first row
							0x00000038 // left alt 
							0x0100000B // number 0
							0x02000034 // full stop
							0x03000039 // space
							0x0400001C // enter
							//second row
							0x0001002D // letter x	
							0x01010002 // number 1
							0x02010003 // number 2
							0x03010004 // number 3
							0x0401000F // tab
							//third row 
							0x00020011 // letter w 
							0x01020005 // number 4	
							0x02020006 // number 5
							0x03020007 // number 6
							0x0402004E // + symbol
							//fourth row
							0x00030012 // letter E 
							0x01030008 // number 7
							0x02030009 // number 8
							0x0303000A // number 9
							0x0403000C // minus 
							//fifth row
							0x0004000E // backspace 
							0x01040014 // letter T
							0x020400B3 // open bracket
							0x030400B4 // closed bracket
							0x04040037 // asterisk
							//sixth row
							0x00050015 // letter Y  
							0x01050050 // KEY_KP2
							0x02050017 // letter i
							0x03050018 // letter o
							0x04050019 // letter p 
							//seventh row
							0x0006001E // letter a  
							0x0106004C // KEY_KP5
							0x02060020 // letter d
							0x03060021 // letter f
							0x04060001 // KEY_ESC
							//eighth row
							0x0007001D // KEY_LEFTCTRL 
							0x01070048 // KEY_KP8
							0x02070025 // letter k
							0x03070026   //letter l
							0x0407000E  // KEY_BACKSPACE
							// arrow keys
							0x0504006C // down
							0x0505006A // right
							0x05060069 // left
							0x05070067 // up
							>;
					};
				};
		};
		
		fragment@1 {
			target = <&gpio>;
			__overlay__ {
				keypad_pins: keypad_pins {
					brcm,pins = < 2 3 5 6 9 10 11 13 15 16 19 20 26 27 >;
					brcm,function = <0>;
					brcm,pull = <1>;
				};
			};
		};
	};